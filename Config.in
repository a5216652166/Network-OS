## Config.in
```kconfig
#
# For a description of the syntax of this configuration file,
# see scripts/kbuild/config-language.txt.
#

mainmenu "Network-OS"

choice
	prompt "Platform"
	default PLATFORM_LINUX
	help
	  There are 1 Platforms currently we support:
	  - Linux: Run Linux as a router

config PLATFORM_LINUX
	bool "Linux"

endchoice

menu 'Layer 2 Config'

config LAYER2
	bool "Enables Layer 2 Support"
	default y
	help
	  Enables Layer2 Support
if LAYER2

config BRIDGE_FDB
	bool "Enable FDB"
	default y
	help
	  Enables Bridge 

config STP
	bool "Enable Spanning Tree"
	default y
	depends on BRIDGE_FDB
	help
	   Say Y here if you want STP to be enabled

config RSTP
	bool "Enable Rapid Spanning Tree"
	default y
	help
	   Say Y here if you want RSTP to be enabled
config LINUX_STP
	bool "Enable Linux Spanning Tree"
	default y
	depends on PLATFORM_LINUX
	help
	   Say Y here if you want Linux STP to be enabled
endif
endmenu

menu 'Layer 3 Config'

config LAYER3
	bool "Enables Layer 3 Support"
	default y
	help
	  Enables Layer3 Support
if LAYER3

config BGP
	bool "Enables BGP Support - Experimental"
	default n
	help
	  Enables BGP Support

config OSPF
	bool "Enables OSPF Support"
	default y
	help
	  Enables OSPF Support

config RIP
	bool "Enables RIP Support - Experimental"
	default n
	help
	  Enables RIP Support

config  ISISD
        bool "Enables ISISD Support - Experimental"
        default n
        help
          Enables ISISD Support

config  BABELD
        bool "Enables BABELD Support - Experimental"
        default n
        help
          Enables BABELD Support
endif


endmenu

menu 'Application Layer'

config APPS
	bool "Enables Application"
	default n
	help
	  Enables Application Support

config TELNET
	bool "Telnet client/server"
	default y
	help
	  This Enables telnet client and server in your Switch

config TFTP
	bool "TFTP client/server"
	default y
	help
	  This Enables TFTP client and server in your Switch

config TRACE_ROUTE
	bool "Traceroute"
	default y
	help
	   Say Y here if you want traceroute to be enabled

config DHCP
	bool "DHCP Server and Client"
	default y
	help
	   Say Y here if you want DHCP server and Client to be enabled

config NTP
	bool "NTP Client, Server"
	default y
	help
	   Say Y here if you want NTP Client and Server to be enabled
endmenu


menu 'System Config'
choice
	prompt "Timers"
	default LIGHT_WEIGHT_TIMERS
	help
	  There are 3 Timers currently we support:
	  - Generic timers : We most efficient but resource consuming.
	  - Light weight timers: Light weight timers consumes less memory
	  - OS Timers : Not Supoorted

config GEN_TIMERS
	bool "Generic Timers"

config LIGHT_WEIGHT_TIMERS
	bool "Light weight Timers"
endchoice

config MAX_PHY_PORTS
	int "Maximux Physical Ports"
	default 6
	help
	   Enter Maximum Physical Ports
endmenu


menu 'Debugging Options'

config DEBUG
	bool "Build with extra Debugging symbols"
	default y
	help
	  Say Y here if you wish to examine Network-OS internals while
	  running. This increases the size of the binary considerably, and
	  should only be used when doing development. If you are doing
	  development and want to debug it, answer Y.

	  Most people should answer N.

config DEBUG_PESSIMIZE
	bool "Disable compiler optimizations"
	default y
	depends on DEBUG
	help
	  The compiler's optimization of source code can eliminate and reorder
	  code, resulting in an executable that's hard to understand when
	  stepping through it with a debugger. This switches it off, resulting
	  in a much bigger executable that more closely matches the source
	  code.

config WERROR
	bool "Abort compilation on any warning"
	default n
	help
	  Selecting this will add -Werror to gcc command line.

	  Most people should answer N.
endmenu
```
